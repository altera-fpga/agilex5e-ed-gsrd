## dk-a5e065ab32aea-nand/baseline-a55/software/yocto_linux/kas/image/Kconfig
```kconfig
menu "Image target selection"

choice
	prompt "Image target selection"
	default CONSOLE_IMAGE_MINIMAL

config CONSOLE_IMAGE_MINIMAL
	bool "Console Image Minimal"
	help
	  Select this to build console image minimal(console-image-minimal) target.

config CORE_IMAGE_MINIMAL
	bool "Core Image Minimal"
	help
	  Select this to build core image minimal(core-image-minimal) target.

config SELECT_ALL_IMAGES
	bool "Select all image targets"
	help
	  Select this to build all image targets(console-image-minimal & core-image-minimal).
endchoice

# Define build flags
config CONSOLE_IMAGE_MINIMAL_BUILD
	bool
	default y if CONSOLE_IMAGE_MINIMAL || SELECT_ALL_IMAGES

config CORE_IMAGE_MINIMAL_BUILD
	bool
	default y if CORE_IMAGE_MINIMAL || SELECT_ALL_IMAGES

# KAS include logic
config KAS_INCLUDE_IMAGE
	string
	default "kas/image/console-image-minimal.yaml" if CONSOLE_IMAGE_MINIMAL
	default "kas/image/core-image-minimal.yaml" if CORE_IMAGE_MINIMAL
	default "kas/image/all-image-targets.yaml" if SELECT_ALL_IMAGES

endmenu
```
