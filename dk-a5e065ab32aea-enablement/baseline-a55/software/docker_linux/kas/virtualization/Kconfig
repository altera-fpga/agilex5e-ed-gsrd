## dk-a5e065ab32aea-enablement/baseline-a55/software/docker_linux/kas/virtualization/Kconfig
```kconfig
menu "Virtualization Options"

config SD_ONLY
    string
    default "1" if ENABLE_DOCKER_BUILD
    default "0"

config ALWAYS_DOCKER
    bool
    default y if SSBL_BOOT_SRC_SD_MMC_CARD
    depends on SSBL_BOOT_SRC_SD_MMC_CARD
    help
      Hidden anchor retained for compatibility; avoid using 'select' here since it bypasses dependencies.
      Docker options are shown/enabled via defaults when booting from SD/MMC.

config ENABLE_DOCKER_BUILD
    bool "Enable Docker Support"
    default y
    depends on SSBL_BOOT_SRC_SD_MMC_CARD
    help
      This option adds Docker container support to the Linux image. It uses the meta-virtualization layer and packages required for the Docker framework.

config KAS_INCLUDE_DOCKER
    string
    default "docker_enable.yml" if ENABLE_DOCKER_BUILD
    default ""


menuconfig DOCKER_MENU
    bool "Docker Options"
    depends on ENABLE_DOCKER_BUILD
    default y
    help
      Submenu for Docker container options.

if DOCKER_MENU

config DOCKER_STATE_START_DAEMON
    bool "Start Docker daemon at Boot"
    default y
    help
      If enabled, systemd will start docker.service at boot.

config DOCKER_LIST_IMAGES
    string "Docker images list (comma-delimited, up to 4)"
    default "docker.io/library/hello-world:latest"
    help
      Comma-separated list of up to 4 Docker images.
      Default packs a single hello-world image. For a multi-image example
      (up to 4 slots), see docker-images.cfg and
      docker-images-override.cfg.example in this directory.
      Supported format examples: docker.io/library/alpine:3.19,
                                 gcr.io/project-id/image:tag,
      or a local image archive: file:///path/on/build-host/image.tar

config DOCKER_LIST_RUN_ARGS
    string "Docker run arguments per image (comma-delimited, up to 4)"
    default "--name=hello|no"
    help
      Comma-separated list of Docker run arguments. Each entry maps to the image
      at the same position in Docker image list above. The trailing |yes/no controls whether to
      start the container on first boot.
      Default matches the single hello-world image (not started on first boot).
      For a multi-image example, see docker-images.cfg and
      docker-images-override.cfg.example in this directory.
      e.g. "--name=alpine --network=host --restart=unless-stopped|yes,--name=localapp -v /data:/data|no,--name=hello|yes"
      Format per entry:
        <docker run flags and options>|{yes|no}

endif  # DOCKER_MENU

endmenu
```

## mk-a5e065ab32aea/desktop-linux-dp/software/yocto_linux/Kconfig
```kconfig
mainmenu "Agilex5e Yocto Build GUI"

config KAS_INCLUDE_DEFAULT
	string
	default "kas.yml"

menu "FPGA Options"

# This design boots from SD/MMC only (no QSPI support).
config SSBL_BOOT_SRC_SD_MMC_CARD
    bool
    default y

config KERNEL_BOOTARGS_SD_MMC
    string "Linux kernel bootargs"
    default "console=ttyS0,115200 earlycon root=/dev/mmcblk0p2 rw rootwait panic=-1"
    help
      Command line parameters for Linux Kernel(bootargs)

config SSBL_BOOT_SOURCE
	string
	default "mmc0"

config FPGA_ENABLE_CORE_PGM_CONFIG
    bool "Enable core RBF FPGA configuration"
    default y
    help
      Enable this option to perform core RBF FPGA programming, applicable only for HPS boot first.

config FPGA_ENABLE_CORE_PGM
    string
    default "1" if FPGA_ENABLE_CORE_PGM_CONFIG
    default "0"

config CORE_IMAGE_EXTRA_INSTALL
    string
    default "fpga-bitstream" if FPGA_ENABLE_CORE_PGM_CONFIG

config FPGA_RBF_FILE
    string "Core RBF configuration bitstream filename"
    default "desktop_linux_dp_hps_debug.core.rbf"
    depends on FPGA_ENABLE_CORE_PGM_CONFIG
    help
      Specify the .rbf file for FPGA programming. It's expected that the RBF file is located under meta-custom/recipes-fpga/fpga-bitstream/files/.
endmenu

source "kas/image/Kconfig"
source "kas/gsrd/Kconfig"
source "kas/apps/Kconfig"
source "kas/virtualization/Kconfig"
```

## mk-a5e065ab32aea/desktop-linux-dp/software/yocto_linux/kas/virtualization/Kconfig
```kconfig
menu "Virtualization Options"

config ENABLE_XEN_BUILD
    bool "Enable XEN Hypervisor Build (SD/MMC only)"
    default n
    depends on SSBL_BOOT_SRC_SD_MMC_CARD
    help
      Enable XEN hypervisor support. This will add meta-virtualization layer,
      include Xen tools and related virtualization features in the build.
      
      XEN is only supported for SD/MMC card boot and is mutually exclusive
      with QSPI NOR Flash boot.
      
      When enabled, this adds:
      - meta-virtualization and meta-filesystems layers
      - Xen tools and net-tools packages
      - virtualization and xen DISTRO_FEATURES
      - XEN device tree repository for passthrough examples
      
      The build will generate multiple images:
      - xen-image-minimal (XEN-specific minimal image)
      - console-image-minimal (Standard console image)
      - gsrd-console-image (Full GSRD image)

config HYP_BUILD
    string
    default "1" if ENABLE_XEN_BUILD
    default "0"

config KAS_INCLUDE_VIRTUALIZATION
    string
    default "xen_enable.yml" if ENABLE_XEN_BUILD
    default ""

endmenu
```
