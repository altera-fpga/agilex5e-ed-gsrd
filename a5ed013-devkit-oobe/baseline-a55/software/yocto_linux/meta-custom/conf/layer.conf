## a5ed013-devkit-oobe/baseline-a55/software/yocto_linux/meta-custom/conf/layer.conf
```bitbake
# We have a conf and classes directory, add to BBPATH
BBPATH .= ":${LAYERDIR}"

# We have recipes-* directories, add to BBFILES
BBFILES += "${LAYERDIR}/recipes-*/*/*.bb \
            ${LAYERDIR}/recipes-*/*/*/*.bb \
            ${LAYERDIR}/recipes-*/*/*.bbappend"

BBFILE_COLLECTIONS += "meta_custom"
BBFILE_PATTERN_meta_custom = "^${LAYERDIR}/"
LAYERDIR_meta_custom := "${LAYERDIR}"
export LAYERDIR_meta_custom


BBFILE_PRIORITY_meta_custom = "6"

LAYERDEPENDS_meta_custom = "core"
LAYERSERIES_COMPAT_meta_custom = "main styhead scarthgap"

CUSTOM_UBOOT_DT = "${CUSTOM_UBOOT_DEVICE_TREE}"
CUSTOM_LINUX_DT = "${CUSTOM_LINUX_DEVICE_TREE}"

FPGA_CORE_PGM_ENABLE = "${FPGA_ENABLE_CORE_PGM}"

SSBL_BOOT_SRC = "${SSBL_BOOT_SOURCE}"

KERNEL_BOOTARGS = "${@ ' '.join([d.getVar('KERNEL_BOOTARGS_SD_MMC') if d.getVar('SSBL_BOOT_SRC') == 'mmc0' \
    else d.getVar('KERNEL_BOOTARGS_QSPI') if d.getVar('SSBL_BOOT_SRC') == 'qspi' else ''])}"

GSRD_APP_SYSCHK ??= "true"
SYSCHK_APP = "${GSRD_APP_SYSCHK}"
GSRD_APP_LED_CTRL ??= "true"
LED_CTRL_APP = "${GSRD_APP_LED_CTRL}"
GSRD_APP_REMOTE_DEBUG ??= "false"
REMOTE_DEBUG_APP = "${GSRD_APP_REMOTE_DEBUG}"
GSRD_APP_GPIO_INT_TEST ??= "true"
GPIO_INT_TEST = "${GSRD_APP_GPIO_INT_TEST}"
NET_APP_LINUXPTP ??= "true"
LINUXPTP_APP = "${NET_APP_LINUXPTP}"
NET_LIB_OPEN62541 ??= "true"
OPEN62541_LIB = "${NET_LIB_OPEN62541}"
GSRD_APP_HELLO_WORLD ??= "true"
HELLO_WORLD_APP = "${GSRD_APP_HELLO_WORLD}"

IMAGE_INSTALL:append = "${@bb.utils.contains('GPIO_INT_TEST', 'true', ' pio-interrupt', '', d) if d.getVar('SSBL_BOOT_SOURCE') != 'qspi' else ''}"
IMAGE_INSTALL:append = "${@bb.utils.contains('HELLO_WORLD_APP', 'true', ' hello', '', d) if d.getVar('SSBL_BOOT_SOURCE') != 'qspi' else ''}"
IMAGE_INSTALL:append = "${@'' if d.getVar('SSBL_BOOT_SOURCE') == 'qspi' else ' rootfs-files'}"

# Add variables for wic creation of sdcard image
IMAGE_BOOT_FILES = " \
		uboot.env \
		boot.scr.uimg \
		u-boot.itb \
		kernel.itb \
		"
```

## a5ed065b-modular-devkit-som/baseline-a55/software/yocto_linux/kas/image/Kconfig
```kconfig
menu "Image target selection"

choice
	prompt "Image target selection"
	default GSRD_CONSOLE_IMAGE

config GSRD_CONSOLE_IMAGE
	bool "GSRD Console Image"
	help
	  Select this to build GSRD console image(gsrd-console-image) target.

config CONSOLE_IMAGE_MINIMAL
	bool "Console Image Minimal"
	help
	  Select this to build console image minimal(console-image-minimal) target.

config CORE_IMAGE_MINIMAL
	bool "Core Image Minimal"
	help
	  Select this to build core image minimal(core-image-minimal) target.

config SELECT_ALL_IMAGES
	bool "Select all image targets"
	help
	  Select this to build all image targets(console-image-minimal,gsrd-console-image & core-image-minimal).
endchoice

# Define build flags
config CONSOLE_IMAGE_MINIMAL_BUILD
	bool
	default y if CONSOLE_IMAGE_MINIMAL || SELECT_ALL_IMAGES

config GSRD_CONSOLE_IMAGE_BUILD
	bool
	default y if GSRD_CONSOLE_IMAGE || SELECT_ALL_IMAGES

config CORE_IMAGE_MINIMAL_BUILD
	bool
	default y if CORE_IMAGE_MINIMAL || SELECT_ALL_IMAGES

# KAS include logic
config KAS_INCLUDE_IMAGE
	string
	default "kas/image/console-image-minimal.yaml" if CONSOLE_IMAGE_MINIMAL
	default "kas/image/gsrd-console-image.yaml" if GSRD_CONSOLE_IMAGE
	default "kas/image/core-image-minimal.yaml" if CORE_IMAGE_MINIMAL
	default "kas/image/all-image-targets.yaml" if SELECT_ALL_IMAGES

endmenu
```

## a5ed065b-premium-devkit-oobe/tsn-cfg2/software/yocto_linux/kas/apps/Kconfig
```kconfig
menu "Example applications"

config HELLO_WORLD_APP
	bool "Hello World"
    default y

endmenu
```

## a5ed065es-modular-devkit-som/baseline-a55/software/yocto_linux/Kconfig
```kconfig
mainmenu "Agilex5e Yocto Build GUI"

config KAS_INCLUDE_DEFAULT
	string
	default "kas.yml"

menu "FPGA Options"

choice
    prompt "SSBL Boot Source"
    default SSBL_BOOT_SRC_SD_MMC_CARD

config SSBL_BOOT_SRC_SD_MMC_CARD
    bool "SD/MMC CARD"
    help
      Boot from SD/MMC card.

config KERNEL_BOOTARGS_SD_MMC
    string "Linux kernel bootargs"
    default "console=ttyS0,115200 earlycon root=/dev/mmcblk0p2 rw rootwait panic=-1"
    depends on SSBL_BOOT_SRC_SD_MMC_CARD
    help
      Command line parameters for Linux Kernel(bootargs)
      sdmmc - console=ttyS0,115200 earlycon root=/dev/mmcblk0p2 rw rootwait panic=-1

config SSBL_BOOT_SRC_QSPI_NOR_FLASH
    bool "QSPI NOR Flash"
    help
      Boot from QSPI NOR Flash.

config KERNEL_BOOTARGS_QSPI
    string "Linux kernel bootargs"
    default "console=ttyS0,115200 earlycon ubi.mtd=1 root=ubi0:rootfs rootfstype=ubifs rw rootwait panic=-1"
    depends on SSBL_BOOT_SRC_QSPI_NOR_FLASH
    help
      Command line parameters for Linux Kernel(bootargs)
      qspi - console=ttyS0,115200 earlycon ubi.mtd=1 root=ubi0:rootfs rootfstype=ubifs rw rootwait panic=-1

config SSBL_BOOT_SRC_SCAN_ALL
    bool "Scan All Boot Sources"
    help
      SSBL boot source - scan all boot sources and boot from detected source.

endchoice

config SSBL_BOOT_SOURCE
	string
	default "mmc0" if SSBL_BOOT_SRC_SD_MMC_CARD
	default "qspi" if SSBL_BOOT_SRC_QSPI_NOR_FLASH
	default "mmc0 qspi" if SSBL_BOOT_SRC_SCAN_ALL

config FPGA_ENABLE_CORE_PGM_CONFIG
    bool "Enable core RBF FPGA configuration"
    default y
    help
      Enable this option to perform core RBF FPGA programming, applicable only for HPS boot first.

config FPGA_ENABLE_CORE_PGM
    string
    default "1" if FPGA_ENABLE_CORE_PGM_CONFIG
    default "0"

config CORE_IMAGE_EXTRA_INSTALL
    string
    default "fpga-bitstream" if FPGA_ENABLE_CORE_PGM_CONFIG

config FPGA_RBF_FILE
    string "Core RBF configuration bitstream filename"
    default "baseline_a55_hps_debug.core.rbf"
    depends on FPGA_ENABLE_CORE_PGM_CONFIG
    help
      Specify the .rbf file for FPGA programming. It's expected that the RBF file is located under meta-custom/recipes-fpga/fpga-bitstream/files/.
endmenu

source "kas/image/Kconfig"
source "kas/gsrd/Kconfig"
source "kas/apps/Kconfig"
```

## a5ed065es-premium-devkit-oobe/baseline-a55/software/yocto_linux/kas/gsrd/Kconfig
```kconfig
if GSRD_CONSOLE_IMAGE_BUILD
menu "Networking libraries and applications"

config APP_LINUXPTP
    bool "linuxptp"
    default y
    help
      linuxptp - Linux precision time protocol implementation for clock
      synchronization over networks.

config LIB_OPEN62541
    bool "open62541 library"
    default y
    help
      open62541 - OPC UA library for embedded systems.

config NET_APP_LINUXPTP
    string
    default "true" if APP_LINUXPTP
    default "false" if !APP_LINUXPTP

config NET_LIB_OPEN62541
    string
    default "true" if LIB_OPEN62541
    default "false" if !LIB_OPEN62541

endmenu
endif

if GSRD_CONSOLE_IMAGE_BUILD
menu "Benchmarking applications"

config APP_COREMARK
    bool "CoreMark"
    default n
    help
      CoreMark - EEMBC benchmark for evaluating embedded CPU performance
      through lightweight core tests.

config BENCHMARK_APP_COREMARK
    string
    default "true" if APP_COREMARK
    default "false" if !APP_COREMARK

config UTIL_NUMACTL
    bool "numactl"
    default n
    help
      numactl - Utility to control NUMA memory and CPU affinity policies for
      performance optimization on NUMA architectures.

config TOOLS_UTIL_NUMACTL
    string
    default "true" if UTIL_NUMACTL
    default "false" if !UTIL_NUMACTL

endmenu
endif

menu "Altera Linux applications"

config APP_SYSCHK
    bool "Syschk"
    default n
    help
      syschk - System Check application located under the intelFPGA directory and 
      provides a glance of system status of basic peripherals such as:
        Power management device information : Input Voltage (vin), output voltage (vout1), output current (iout1)
        USB: USB device driver
        SysID : FPGA system ID
        Network IP (IPv4) : Network IP address
        HPS LEDs : HPS LED state
        FPGA LEDs : FPGA LED state

config APP_LED_CTRL
    bool "LED control"
    default y
    help
      LED control - Set of user space apps (blink, toggle, scroll_client and scroll_server)
      to test and demonstrate the LED functionality on SoC FPGA platforms. For more info,
      refer meta-altera-fpga/meta-altera-platform/recipes-gsrd/gsrd-apps/files/README.

config APP_REMOTE_DEBUG
    bool "Remote debug"
    depends on GSRD_CONSOLE_IMAGE_BUILD
    default n
    help
      Remote debug application - Network-accessible debug interface for SoC FPGA platforms.
      https://github.com/altera-fpga/remote-debug-for-intel-fpga/blob/main/README.md
      https://altera-fpga.github.io/rel-25.1/embedded-designs/agilex-5/e-series/premium/remote-debug/ug-remote-debug-agx5e-premium/

config APP_TSN_REF_SW
    bool "TSN reference software"
    depends on GSRD_CONSOLE_IMAGE_BUILD
    default n
    help
      tsn-ref-sw - Time-Sensitive Networking Reference Software.
      https://github.com/intel/iotg_tsn_ref_sw/blob/master/README.md

config APP_GPIO_INT_TEST
    bool "GPIO interrupt"
    default y
    help
      GPIO Interrupt - Enables registration and handling of GPIO based interrupts
      (e.g buttons, switches) on SoC FPGA platforms.

config GSRD_APP_SYSCHK
    string
    default "true" if APP_SYSCHK
    default "false" if !APP_SYSCHK

config GSRD_APP_LED_CTRL
    string
    default "true" if APP_LED_CTRL
    default "false" if !APP_LED_CTRL

config GSRD_APP_REMOTE_DEBUG
    string
    default "true" if APP_REMOTE_DEBUG
    default "false" if !APP_REMOTE_DEBUG

config GSRD_APP_TSN_REF_SW
    string
    default "true" if APP_TSN_REF_SW
    default "false" if !APP_TSN_REF_SW

config GSRD_APP_GPIO_INT_TEST
    string
    default "true" if APP_GPIO_INT_TEST
    default "false" if !APP_GPIO_INT_TEST

endmenu
```

## a5ed065es-premium-devkit-oobe/baseline-a55/software/yocto_linux/meta-custom/conf/machine/agilex5e.conf
```bitbake
UBOOT_CONFIG = "agilex5e-socdk-atf"
UBOOT_CONFIG[agilex5e-socdk-atf] = "socfpga_agilex5_defconfig"

require conf/machine/machine.conf
require conf/machine/include/ubifs.inc
```

## a5ed065es-premium-devkit-oobe/baseline-a55/software/yocto_linux/meta-custom/conf/machine/ubifs.inc
```bitbake
# Settings for ubifs
MKUBIFS_ARGS ?= "--leb-size 126976 --min-io-size 2048 --max-leb-cnt 7700"
UBINIZE_ARGS ?= "--peb-size 128KiB --min-io-size 2048 --sub-page-size 2048"
MULTIUBI_BUILD += "nand"
MKUBIFS_ARGS_nand ?= "--leb-size 126976 --min-io-size 2048 --max-leb-cnt 7700"
UBINIZE_ARGS_nand ?= "--peb-size 128KiB --min-io-size 2048 --sub-page-size 2048"
MULTIUBI_BUILD += "nor"
MKUBIFS_ARGS_nor ?= "-F -e 65408 -m 1 -c 7700"
UBINIZE_ARGS_nor ?= "-p 65536 -m 1 -s 1"
```

## a5ed065es-premium-devkit-oobe/baseline-a76/software/yocto_linux/meta-custom/conf/layer.conf
```bitbake
# We have a conf and classes directory, add to BBPATH
BBPATH .= ":${LAYERDIR}"

# We have recipes-* directories, add to BBFILES
BBFILES += "${LAYERDIR}/recipes-*/*/*.bb \
            ${LAYERDIR}/recipes-*/*/*/*.bb \
            ${LAYERDIR}/recipes-*/*/*.bbappend"

BBFILE_COLLECTIONS += "meta-custom"
BBFILE_PATTERN_meta-custom = "^${LAYERDIR}/"
BBFILE_PRIORITY_meta-custom = "6"

LAYERDEPENDS_meta-custom = "core"
LAYERSERIES_COMPAT_meta-custom = "main styhead walnascar"

CUSTOM_UBOOT_DT = "${CUSTOM_UBOOT_DEVICE_TREE}"
CUSTOM_LINUX_DT = "${CUSTOM_LINUX_DEVICE_TREE}"

FPGA_CORE_PGM_ENABLE = "${FPGA_ENABLE_CORE_PGM}"

SSBL_BOOT_SRC = "${SSBL_BOOT_SOURCE}"

KERNEL_BOOTARGS = "${@ ' '.join([d.getVar('KERNEL_BOOTARGS_SD_MMC') if d.getVar('SSBL_BOOT_SRC') == 'mmc0' \
    else d.getVar('KERNEL_BOOTARGS_QSPI') if d.getVar('SSBL_BOOT_SRC') == 'qspi' else ''])}"

SYSCHK_APP = "${GSRD_APP_SYSCHK}"
LED_CTRL_APP = "${GSRD_APP_LED_CTRL}"
REMOTE_DEBUG_APP = "${GSRD_APP_REMOTE_DEBUG}"
TSN_REF_SW = "${GSRD_APP_TSN_REF_SW}"
GPIO_INT_TEST = "${GSRD_APP_GPIO_INT_TEST}"
LINUXPTP_APP = "${NET_APP_LINUXPTP}"
OPEN62541_LIB = "${NET_LIB_OPEN62541}"
COREMARK_APP = "${BENCHMARK_APP_COREMARK}"
NUMACTL_UTIL = "${TOOLS_UTIL_NUMACTL}"

IMAGE_INSTALL:append = " hello-module"

# Add variables for wic creation of sdcard image
IMAGE_BOOT_FILES = " \
		uboot.env \
		boot.scr.uimg \
		u-boot.itb \
		kernel.itb \
		"
```

## a5ed065es-premium-devkit-oobe/baseline/software/yocto_linux/kas/apps/Kconfig
```kconfig
menu "Example applications"

config HELLO_WORLD_APP
	bool "Hello World"
    default y

config KAS_INCLUDE_HELLO_WORLD_APP
	string
	default "kas/apps/hello-world.yaml" if HELLO_WORLD_APP

endmenu
```

## a5ed065es-premium-devkit-oobe/baseline/software/yocto_linux/kas/image/Kconfig
```kconfig
menu "Image target selection"

choice
	prompt "Image target selection"
	default CONSOLE_IMAGE_MINIMAL

config CONSOLE_IMAGE_MINIMAL
	bool "Console Image Minimal"
	help
	  Select this to build console image minimal(console-image-minimal) target.

config GSRD_CONSOLE_IMAGE
	bool "GSRD Console Image"
	help
	  Select this to build GSRD console image(gsrd-console-image) target.

config CORE_IMAGE_MINIMAL
	bool "Core Image Minimal"
	help
	  Select this to build core image minimal(core-image-minimal) target.

config SELECT_ALL_IMAGES
    bool "Select all image targets"
	help
	  Select this to build all image targets(console-image-minimal,gsrd-console-image & core-image-minimal).
endchoice

if CONSOLE_IMAGE_MINIMAL
config CONSOLE_IMAGE_MINIMAL_BUILD
    bool
    default y
endif

if GSRD_CONSOLE_IMAGE
config GSRD_CONSOLE_IMAGE_BUILD
    bool
    default y
endif

if CORE_IMAGE_MINIMAL
config CORE_IMAGE_MINIMAL_BUILD
    bool
    default y
endif

if SELECT_ALL_IMAGES
config CONSOLE_IMAGE_MINIMAL_BUILD
    bool
    default y
config GSRD_CONSOLE_IMAGE_BUILD
    bool
    default y
config CORE_IMAGE_MINIMAL_BUILD
    bool
    default y
endif

config KAS_INCLUDE_IMAGE
	string
	default "kas/image/console-image-minimal.yaml" if CONSOLE_IMAGE_MINIMAL
	default "kas/image/gsrd-console-image.yaml" if GSRD_CONSOLE_IMAGE
	default "kas/image/core-image-minimal.yaml" if CORE_IMAGE_MINIMAL
	default "kas/image/all-image-targets.yaml" if SELECT_ALL_IMAGES

endmenu
```

## dk-a5e065ab32aea-nand/baseline-a55/software/yocto_linux/kas/gsrd/Kconfig
```kconfig
menu "Altera Linux applications"

config APP_SYSCHK
    bool "Syschk"
    default y
    help
      syschk - System Check application located under the alteraFPGA directory and 
      provides a glance of system status of basic peripherals such as:
        Power management device information : Input Voltage (vin), output voltage (vout1), output current (iout1)
        USB: USB device driver
        SysID : FPGA system ID
        Network IP (IPv4) : Network IP address
        HPS LEDs : HPS LED state
        FPGA LEDs : FPGA LED state

config APP_LED_CTRL
    bool "LED control"
    default y
    help
      LED control - Set of user space apps (blink, toggle, scroll_client and scroll_server)
      to test and demonstrate the LED functionality on SoC FPGA platforms. For more info,
      refer meta-altera-fpga/meta-altera-platform/recipes-gsrd/gsrd-apps/files/README.

config APP_GPIO_INT_TEST
    bool "GPIO interrupt"
    default y
    help
      GPIO Interrupt - Enables registration and handling of GPIO based interrupts
      (e.g buttons, switches) on SoC FPGA platforms.

config GSRD_APP_SYSCHK
    string
    default "true" if APP_SYSCHK
    default "false" if !APP_SYSCHK

config GSRD_APP_LED_CTRL
    string
    default "true" if APP_LED_CTRL
    default "false" if !APP_LED_CTRL

config GSRD_APP_GPIO_INT_TEST
    string
    default "true" if APP_GPIO_INT_TEST
    default "false" if !APP_GPIO_INT_TEST

endmenu
```
